#include "led_plate.h"

#define SINGEL_FRAME_DURATION 6000
#define MULTIPLE_FRAME_DURATION SINGEL_FRAME_DURATION / 6

const Image baseImages[] = {
    // Files count: 11

    // ./imgs\0\..
    (Image){{
                // ./imgs\0\0.png
                (Frame){.pixels =
                            {
                                {0, 0, 0}, {0, 0, 0},       {0, 0, 0},       {0, 0, 0},       {0, 0, 0},       {228, 205, 212}, {0, 0, 0},       {0, 0, 0},       {0, 0, 0},       {0, 0, 0},
                                {0, 0, 0}, {0, 0, 0},       {0, 0, 0},       {0, 0, 0},       {228, 205, 212}, {255, 2, 106},   {228, 205, 212}, {0, 0, 0},       {0, 0, 0},       {0, 0, 0},
                                {0, 0, 0}, {0, 0, 0},       {0, 0, 0},       {228, 205, 212}, {255, 2, 182},   {255, 2, 182},   {255, 2, 182},   {228, 205, 212}, {0, 0, 0},       {0, 0, 0},
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                                {0, 0, 0}, {0, 0, 0},       {0, 0, 0},       {0, 0, 0},       {0, 0, 0},       {0, 0, 0},       {0, 0, 0},       {0, 0, 0},       {0, 0, 0},       {0, 0, 0},
                            },
                        .duration = MULTIPLE_FRAME_DURATION},
                // ./imgs\0\1.png
                (Frame){.pixels =
                            {
                                {0, 0, 0},       {0, 0, 0},       {0, 0, 0},       {0, 0, 0},       {255, 254, 207}, {0, 0, 0},       {0, 0, 0},       {0, 0, 0},       {0, 0, 0},       {0, 0, 0},
                                {0, 0, 0},       {0, 0, 0},       {0, 0, 0},       {255, 254, 207}, {255, 89, 0},    {255, 254, 207}, {0, 0, 0},       {0, 0, 0},       {0, 0, 0},       {0, 0, 0},
                                {0, 0, 0},       {0, 0, 0},       {255, 254, 207}, {255, 174, 82},  {255, 174, 82},  {255, 174, 82},  {255, 254, 207}, {0, 0, 0},       {0, 0, 0},       {0, 0, 0},
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                                {0, 0, 0},       {0, 0, 0},       {0, 0, 0},       {0, 0, 0},       {0, 0, 0},       {0, 0, 0},       {0, 0, 0},       {0, 0, 0},       {0, 0, 0},       {0, 0, 0},
                            },
                        .duration = MULTIPLE_FRAME_DURATION},
                // ./imgs\0\2.png
                (Frame){.pixels =
                            {
                                {0, 0, 0},       {0, 0, 0},       {0, 0, 0},       {0, 0, 0},       {0, 0, 0},       {0, 0, 0},       {0, 0, 0},       {0, 0, 0},       {0, 0, 0},       {0, 0, 0},
                                {0, 0, 0},       {0, 0, 0},       {0, 0, 0},       {0, 0, 0},       {201, 238, 232}, {0, 0, 0},       {0, 0, 0},       {0, 0, 0},       {0, 0, 0},       {0, 0, 0},
                                {0, 0, 0},       {0, 0, 0},       {0, 0, 0},       {201, 238, 232}, {0, 144, 132},   {201, 238, 232}, {0, 0, 0},       {0, 0, 0},       {0, 0, 0},       {0, 0, 0},
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                                {0, 0, 0},       {0, 0, 0},       {0, 0, 0},       {201, 238, 232}, {201, 238, 232}, {201, 238, 232}, {0, 0, 0},       {0, 0, 0},       {0, 0, 0},       {0, 0, 0},
                            },
                        .duration = MULTIPLE_FRAME_DURATION},
                // ./imgs\0\3.png
                (Frame){.pixels =
                            {
                                {0, 0, 0}, {0, 0, 0},       {0, 0, 0},       {0, 0, 0},       {0, 0, 0},       {0, 0, 0},       {0, 0, 0},       {0, 0, 0},       {0, 0, 0},       {0, 0, 0},
                                {0, 0, 0}, {0, 0, 0},       {0, 0, 0},       {0, 0, 0},       {0, 0, 0},       {218, 189, 225}, {0, 0, 0},       {0, 0, 0},       {0, 0, 0},       {0, 0, 0},
                                {0, 0, 0}, {0, 0, 0},       {0, 0, 0},       {0, 0, 0},       {218, 189, 225}, {103, 48, 120},  {218, 189, 225}, {0, 0, 0},       {0, 0, 0},       {0, 0, 0},
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                                {0, 0, 0}, {0, 0, 0},       {0, 0, 0},       {0, 0, 0},       {218, 189, 225}, {218, 189, 225}, {218, 189, 225}, {0, 0, 0},       {0, 0, 0},       {0, 0, 0},
                            },
                        .duration = MULTIPLE_FRAME_DURATION},
            },
            .shiftMode = 0,
            .framesCount = 4},

    // ./imgs\1\..
    (Image){
        {
            // ./imgs\1\0.png
            (Frame){.pixels =
                        {
                            {0, 0, 0},     {0, 0, 0},     {0, 0, 0},     {0, 0, 0},     {0, 0, 0},     {0, 0, 0},     {0, 0, 0}, {0, 0, 0}, {0, 0, 0},     {0, 0, 0},     {0, 0, 0},     {0, 0, 0},
                            {0, 0, 0},     {0, 0, 0},     {0, 0, 0},     {0, 0, 0},     {0, 0, 0},     {0, 0, 0},     {0, 0, 0}, {0, 0, 0}, {0, 0, 0},     {0, 0, 0},     {0, 0, 0},     {0, 0, 0},
                            {0, 0, 0},     {0, 0, 0},     {0, 0, 0},     {0, 0, 0},     {0, 0, 0},     {0, 0, 0},     {0, 0, 0}, {0, 0, 0}, {0, 0, 0},     {0, 0, 0},     {0, 0, 0},     {0, 0, 0},
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                            {224, 175, 0}, {0, 0, 0},     {0, 0, 0},     {0, 0, 0},
                        },
                    .duration = MULTIPLE_FRAME_DURATION},
            // ./imgs\1\1.png
            (Frame){.pixels =
                        {
                            {0, 0, 0},    {0, 0, 0},     {0, 0, 0},     {0, 0, 0},     {0, 0, 0},     {0, 0, 0},     {0, 0, 0},     {0, 0, 0},     {0, 0, 0},    {0, 0, 0},
                            {0, 0, 0},    {255, 68, 1},  {0, 0, 0},     {0, 0, 0},     {0, 0, 0},     {0, 0, 0},     {0, 0, 0},     {0, 0, 0},     {0, 0, 0},    {0, 0, 0},
                            {0, 0, 0},    {0, 0, 0},     {0, 0, 0},     {0, 0, 0},     {0, 0, 0},     {0, 0, 0},     {0, 0, 0},     {0, 0, 0},     {0, 0, 0},    {0, 0, 0},
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                            {255, 68, 1}, {255, 68, 1},  {224, 175, 0}, {255, 226, 0}, {255, 226, 0}, {255, 226, 0}, {224, 175, 0}, {255, 68, 1},  {0, 0, 0},    {0, 0, 0},
                        },
                    .duration = MULTIPLE_FRAME_DURATION},
            // ./imgs\1\2.png
            (Frame){.pixels =
                        {
                            {0, 0, 0},     {0, 0, 0},     {255, 22, 26}, {0, 0, 0},     {0, 0, 0},     {0, 0, 0},     {0, 0, 0},     {0, 0, 0},     {0, 0, 0},     {0, 0, 0},
                            {0, 0, 0},     {0, 0, 0},     {0, 0, 0},     {255, 22, 26}, {0, 0, 0},     {0, 0, 0},     {0, 0, 0},     {0, 0, 0},     {0, 0, 0},     {0, 0, 0},
                            {0, 0, 0},     {0, 0, 0},     {0, 0, 0},     {255, 22, 26}, {255, 22, 26}, {0, 0, 0},     {0, 0, 0},     {0, 0, 0},     {255, 22, 26}, {0, 0, 0},
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                            {0, 0, 0},     {255, 22, 26}, {255, 22, 26}, {0, 0, 0},     {0, 0, 0},     {0, 0, 0},     {255, 22, 26}, {0, 0, 0},     {0, 0, 0},     {0, 0, 0},
                        },
                    .duration = MULTIPLE_FRAME_DURATION},
            // ./imgs\1\3.png
            (Frame){.pixels =
                        {
                            {0, 0, 0},      {0, 0, 0},      {255, 22, 26},  {217, 17, 245}, {0, 0, 0},      {0, 0, 0},      {0, 0, 0},      {0, 0, 0},      {0, 0, 0},      {0, 0, 0},
                            {0, 0, 0},      {0, 0, 0},      {217, 17, 245}, {255, 22, 26},  {217, 17, 245}, {217, 17, 245}, {217, 17, 245}, {0, 0, 0},      {0, 0, 0},      {217, 17, 245},
                            {0, 0, 0},      {0, 0, 0},      {217, 17, 245}, {255, 22, 26},  {255, 22, 26},  {217, 17, 245}, {217, 17, 245}, {0, 0, 0},      {255, 22, 26},  {0, 0, 0},
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                            {217, 17, 245}, {255, 22, 26},  {255, 22, 26},  {217, 17, 245}, {217, 17, 245}, {217, 17, 245}, {255, 22, 26},  {217, 17, 245}, {217, 17, 245}, {0, 0, 0},
                        },
                    .duration = MULTIPLE_FRAME_DURATION},
            // ./imgs\1\4.png
            (Frame){.pixels =
                        {
                            {0, 0, 0},     {0, 0, 0},      {0, 0, 0},      {0, 0, 0},       {0, 0, 0},       {0, 0, 0},       {0, 240, 237},   {0, 0, 0},      {0, 0, 0},     {0, 0, 0},
                            {0, 0, 0},     {0, 240, 237},  {0, 0, 0},      {0, 0, 0},       {0, 0, 0},       {0, 240, 237},   {0, 0, 0},       {0, 0, 0},      {0, 0, 0},     {0, 0, 0},
                            {0, 0, 0},     {0, 0, 0},      {0, 0, 0},      {0, 240, 237},   {0, 240, 237},   {0, 240, 237},   {0, 0, 0},       {0, 0, 0},      {0, 240, 237}, {0, 240, 237},
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                            {0, 0, 0},     {0, 240, 237},  {0, 240, 237},  {0, 0, 0},       {0, 0, 0},       {0, 0, 0},       {0, 240, 237},   {0, 0, 0},      {0, 0, 0},     {0, 0, 0},
                        },
                    .duration = MULTIPLE_FRAME_DURATION},
        },
        .shiftMode = 0,
        .framesCount = 5},

    // ./imgs\2\..
    (Image){{
                // ./imgs\2\0.png
                (Frame){.pixels =
                            {
                                {50, 143, 192}, {50, 143, 192},  {50, 143, 192},  {50, 143, 192}, {0, 0, 0},     {0, 0, 0},     {50, 143, 192}, {51, 142, 192}, {50, 143, 192}, {50, 143, 192},
                                {50, 143, 192}, {51, 142, 191},  {50, 143, 192},  {0, 0, 0},      {245, 241, 2}, {230, 227, 0}, {0, 0, 0},      {50, 143, 192}, {50, 143, 192}, {50, 143, 192},
                                {48, 142, 191}, {51, 142, 192},  {50, 143, 192},  {0, 0, 0},      {255, 253, 4}, {255, 253, 4}, {0, 0, 0},      {50, 143, 192}, {50, 143, 192}, {50, 143, 192},
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                                {0, 0, 0},      {0, 0, 0},       {0, 0, 0},       {0, 0, 0},      {0, 0, 0},     {0, 0, 0},     {0, 0, 0},      {0, 0, 0},      {0, 0, 0},      {0, 0, 0},
                            },
                        .duration = MULTIPLE_FRAME_DURATION},
                // ./imgs\2\1.png
                (Frame){.pixels =
                            {
                                {50, 143, 192}, {50, 143, 192},  {50, 143, 192},  {50, 143, 192}, {0, 0, 0},     {0, 0, 0},     {50, 143, 192}, {51, 142, 192}, {50, 143, 192}, {50, 143, 192},
                                {50, 143, 192}, {51, 142, 191},  {50, 143, 192},  {0, 0, 0},      {245, 241, 2}, {230, 227, 0}, {0, 0, 0},      {50, 143, 192}, {50, 143, 192}, {50, 143, 192},
                                {48, 142, 191}, {51, 142, 192},  {50, 143, 192},  {0, 0, 0},      {255, 253, 4}, {255, 253, 4}, {0, 0, 0},      {50, 143, 192}, {50, 143, 192}, {50, 143, 192},
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                                {0, 0, 0},      {0, 0, 0},       {0, 0, 0},       {0, 0, 0},      {0, 0, 0},     {0, 0, 0},     {0, 0, 0},      {0, 0, 0},      {0, 0, 0},      {0, 0, 0},
                            },
                        .duration = MULTIPLE_FRAME_DURATION},
                // ./imgs\2\2.png
                (Frame){.pixels =
                            {
                                {50, 143, 192}, {50, 143, 192},  {50, 143, 192},  {50, 143, 192}, {0, 0, 0},     {0, 0, 0},     {50, 143, 192}, {51, 142, 192}, {50, 143, 192}, {50, 143, 192},
                                {50, 143, 192}, {51, 142, 191},  {50, 143, 192},  {0, 0, 0},      {129, 33, 37}, {129, 33, 37}, {0, 0, 0},      {50, 143, 192}, {50, 143, 192}, {50, 143, 192},
                                {48, 142, 191}, {51, 142, 192},  {50, 143, 192},  {0, 0, 0},      {255, 49, 56}, {255, 49, 56}, {0, 0, 0},      {50, 143, 192}, {50, 143, 192}, {50, 143, 192},
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                                {0, 0, 0},      {0, 0, 0},       {0, 0, 0},       {0, 0, 0},      {0, 0, 0},     {0, 0, 0},     {0, 0, 0},      {0, 0, 0},      {0, 0, 0},      {0, 0, 0},
                            },
                        .duration = MULTIPLE_FRAME_DURATION},
                // ./imgs\2\3.png
                (Frame){.pixels =
                            {
                                {50, 143, 192}, {50, 143, 192},  {50, 143, 192},  {50, 143, 192},  {0, 0, 0},       {0, 0, 0},       {50, 143, 192},  {51, 142, 192},  {50, 143, 192}, {50, 143, 192},
                                {50, 143, 192}, {51, 142, 191},  {50, 143, 192},  {0, 0, 0},       {255, 255, 255}, {255, 255, 255}, {0, 0, 0},       {50, 143, 192},  {50, 143, 192}, {50, 143, 192},
                                {48, 142, 191}, {51, 142, 192},  {50, 143, 192},  {0, 0, 0},       {255, 255, 255}, {255, 255, 255}, {0, 0, 0},       {50, 143, 192},  {50, 143, 192}, {50, 143, 192},
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                                {0, 0, 0},      {0, 0, 0},       {0, 0, 0},       {0, 0, 0},       {0, 0, 0},       {0, 0, 0},       {0, 0, 0},       {0, 0, 0},       {0, 0, 0},      {0, 0, 0},
                            },
                        .duration = MULTIPLE_FRAME_DURATION},
                // ./imgs\2\4.png
                (Frame){.pixels =
                            {
                                {50, 143, 192}, {50, 143, 192},  {50, 143, 192},  {50, 143, 192},  {0, 0, 0},       {0, 0, 0},       {50, 143, 192},  {51, 142, 192},  {50, 143, 192}, {50, 143, 192},
                                {50, 143, 192}, {51, 142, 191},  {50, 143, 192},  {0, 0, 0},       {255, 255, 255}, {255, 255, 255}, {0, 0, 0},       {50, 143, 192},  {50, 143, 192}, {50, 143, 192},
                                {48, 142, 191}, {51, 142, 192},  {50, 143, 192},  {0, 0, 0},       {255, 255, 255}, {255, 255, 255}, {0, 0, 0},       {50, 143, 192},  {50, 143, 192}, {50, 143, 192},
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                                {0, 0, 0},      {0, 0, 0},       {0, 0, 0},       {0, 0, 0},       {0, 0, 0},       {0, 0, 0},       {0, 0, 0},       {0, 0, 0},       {0, 0, 0},      {0, 0, 0},
                            },
                        .duration = MULTIPLE_FRAME_DURATION},
                // ./imgs\2\5.png
                (Frame){.pixels =
                            {
                                {50, 143, 192}, {50, 143, 192},  {50, 143, 192},  {50, 143, 192},  {0, 0, 0},       {0, 0, 0},       {50, 143, 192},  {51, 142, 192},  {50, 143, 192}, {50, 143, 192},
                                {50, 143, 192}, {51, 142, 191},  {50, 143, 192},  {0, 0, 0},       {255, 255, 255}, {255, 255, 255}, {0, 0, 0},       {50, 143, 192},  {50, 143, 192}, {50, 143, 192},
                                {48, 142, 191}, {51, 142, 192},  {50, 143, 192},  {0, 0, 0},       {255, 255, 255}, {255, 255, 255}, {0, 0, 0},       {50, 143, 192},  {50, 143, 192}, {50, 143, 192},
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                                {0, 0, 0},      {0, 0, 0},       {0, 0, 0},       {0, 0, 0},       {0, 0, 0},       {0, 0, 0},       {0, 0, 0},       {0, 0, 0},       {0, 0, 0},      {0, 0, 0},
                            },
                        .duration = MULTIPLE_FRAME_DURATION},
            },
            .shiftMode = 0,
            .framesCount = 6},

    // ./imgs\3\..
    (Image){{
                // ./imgs\3\0.png
                (Frame){.pixels =
                            {
                                {0, 0, 0},    {0, 0, 0},    {0, 0, 0},       {0, 255, 0},  {0, 255, 0}, {0, 255, 0}, {0, 124, 42},    {0, 0, 0},       {0, 0, 0},       {0, 0, 0},
                                {0, 0, 0},    {0, 0, 0},    {161, 243, 125}, {0, 255, 0},  {0, 255, 0}, {0, 255, 0}, {0, 255, 0},     {0, 255, 0},     {0, 0, 0},       {0, 0, 0},
                                {0, 0, 0},    {0, 255, 0},  {0, 255, 0},     {0, 0, 0},    {0, 255, 0}, {0, 255, 0}, {0, 0, 0},       {0, 255, 0},     {0, 255, 0},     {0, 0, 0},
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                                {0, 0, 0},    {0, 0, 0},    {0, 0, 0},       {0, 124, 42}, {0, 255, 0}, {0, 255, 0}, {161, 243, 125}, {0, 0, 0},       {0, 0, 0},       {0, 0, 0},
                            },
                        .duration = MULTIPLE_FRAME_DURATION},
                // ./imgs\3\1.png
                (Frame){.pixels =
                            {
                                {0, 0, 0},     {0, 0, 0},     {0, 0, 0},       {255, 242, 0}, {255, 242, 0}, {255, 242, 0}, {155, 146, 0},   {0, 0, 0},       {0, 0, 0},       {0, 0, 0},
                                {0, 0, 0},     {0, 0, 0},     {230, 223, 133}, {255, 242, 0}, {255, 242, 0}, {255, 242, 0}, {255, 242, 0},   {255, 242, 0},   {0, 0, 0},       {0, 0, 0},
                                {0, 0, 0},     {255, 242, 0}, {255, 242, 0},   {0, 0, 0},     {255, 242, 0}, {255, 242, 0}, {0, 0, 0},       {255, 242, 0},   {255, 242, 0},   {0, 0, 0},
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                                {0, 0, 0},     {0, 0, 0},     {0, 0, 0},       {155, 146, 0}, {255, 242, 0}, {255, 242, 0}, {230, 223, 133}, {0, 0, 0},       {0, 0, 0},       {0, 0, 0},
                            },
                        .duration = MULTIPLE_FRAME_DURATION},
                // ./imgs\3\2.png
                (Frame){.pixels =
                            {
                                {0, 0, 0},    {0, 0, 0},     {0, 0, 0},       {255, 141, 0}, {255, 141, 0}, {255, 141, 0}, {115, 61, 0},    {0, 0, 0},       {0, 0, 0},       {0, 0, 0},
                                {0, 0, 0},    {0, 0, 0},     {255, 204, 137}, {255, 141, 0}, {255, 141, 0}, {255, 141, 0}, {255, 141, 0},   {255, 141, 0},   {0, 0, 0},       {0, 0, 0},
                                {0, 0, 0},    {255, 141, 0}, {255, 141, 0},   {0, 0, 0},     {255, 141, 0}, {255, 141, 0}, {0, 0, 0},       {255, 141, 0},   {255, 141, 0},   {0, 0, 0},
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                                {0, 0, 0},    {0, 0, 0},     {0, 0, 0},       {115, 61, 0},  {255, 141, 0}, {255, 141, 0}, {255, 204, 137}, {0, 0, 0},       {0, 0, 0},       {0, 0, 0},
                            },
                        .duration = MULTIPLE_FRAME_DURATION},
                // ./imgs\3\3.png
                (Frame){.pixels =
                            {
                                {0, 0, 0},     {0, 0, 0},     {0, 0, 0},       {255, 0, 0},   {255, 0, 0}, {255, 0, 0},  {142, 17, 17},   {0, 0, 0},       {0, 0, 0},       {0, 0, 0},
                                {0, 0, 0},     {0, 0, 0},     {255, 101, 101}, {255, 0, 0},   {255, 0, 0}, {255, 0, 0},  {238, 16, 5},    {255, 0, 0},     {0, 0, 0},       {0, 0, 0},
                                {0, 0, 0},     {255, 0, 0},   {255, 0, 0},     {0, 0, 0},     {255, 0, 0}, {255, 0, 0},  {0, 0, 0},       {249, 19, 8},    {255, 0, 0},     {0, 0, 0},
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                                {0, 0, 0},     {0, 0, 0},     {0, 0, 0},       {142, 17, 17}, {255, 0, 0}, {255, 34, 0}, {255, 101, 101}, {0, 0, 0},       {0, 0, 0},       {0, 0, 0},
                            },
                        .duration = MULTIPLE_FRAME_DURATION},
                // ./imgs\3\4.png
                (Frame){.pixels =
                            {
                                {0, 0, 0},    {0, 0, 0},     {0, 0, 0},       {103, 78, 78}, {103, 78, 78}, {103, 78, 78}, {38, 38, 38},    {0, 0, 0},       {0, 0, 0},       {0, 0, 0},
                                {0, 0, 0},    {0, 0, 0},     {190, 190, 190}, {103, 78, 78}, {103, 78, 78}, {103, 78, 78}, {103, 78, 78},   {103, 78, 78},   {0, 0, 0},       {0, 0, 0},
                                {0, 0, 0},    {103, 78, 78}, {0, 0, 0},       {103, 78, 78}, {103, 78, 78}, {103, 78, 78}, {0, 0, 0},       {103, 78, 78},   {103, 78, 78},   {0, 0, 0},
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                                {0, 0, 0},    {0, 0, 0},     {0, 0, 0},       {38, 38, 38},  {103, 78, 78}, {103, 78, 78}, {190, 190, 190}, {0, 0, 0},       {0, 0, 0},       {0, 0, 0},
                            },
                        .duration = MULTIPLE_FRAME_DURATION},
            },
            .shiftMode = 0,
            .framesCount = 5},

    // ./imgs\4\..
    (Image){{
                // ./imgs\4\0.png
                (Frame){.pixels =
                            {
                                {0, 0, 0}, {0, 0, 0}, {0, 0, 0},     {0, 0, 0},     {0, 0, 0},       {255, 230, 176}, {255, 230, 176}, {255, 230, 176}, {0, 0, 0},       {0, 0, 0},
                                {0, 0, 0}, {0, 0, 0}, {0, 0, 0},     {0, 0, 0},     {255, 230, 176}, {0, 49, 148},    {255, 230, 176}, {0, 49, 148},    {255, 230, 176}, {0, 0, 0},
                                {0, 0, 0}, {0, 0, 0}, {0, 0, 0},     {0, 0, 0},     {0, 0, 0},       {255, 230, 176}, {255, 230, 176}, {255, 230, 176}, {0, 0, 0},       {0, 0, 0},
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                                {0, 0, 0}, {0, 0, 0}, {0, 0, 0},     {0, 0, 0},     {0, 0, 0},       {0, 0, 0},       {0, 0, 0},       {0, 49, 148},    {0, 0, 0},       {0, 0, 0},
                            },
                        .duration = MULTIPLE_FRAME_DURATION},
                // ./imgs\4\1.png
                (Frame){.pixels =
                            {
                                {0, 0, 0}, {0, 0, 0}, {0, 0, 0},     {0, 0, 0},     {0, 0, 0},       {255, 230, 176}, {255, 230, 176}, {255, 230, 176}, {0, 0, 0},       {0, 0, 0},
                                {0, 0, 0}, {0, 0, 0}, {0, 0, 0},     {0, 0, 0},     {255, 230, 176}, {0, 49, 148},    {255, 230, 176}, {0, 49, 148},    {255, 230, 176}, {0, 0, 0},
                                {0, 0, 0}, {0, 0, 0}, {0, 0, 0},     {0, 0, 0},     {0, 0, 0},       {255, 230, 176}, {255, 230, 176}, {255, 230, 176}, {0, 0, 0},       {0, 0, 0},
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                                {0, 0, 0}, {0, 0, 0}, {0, 0, 0},     {0, 0, 0},     {0, 0, 0},       {0, 0, 0},       {0, 0, 0},       {0, 49, 148},    {0, 0, 0},       {0, 0, 0},
                            },
                        .duration = MULTIPLE_FRAME_DURATION},
                // ./imgs\4\2.png
                (Frame){.pixels =
                            {
                                {0, 0, 0}, {0, 0, 0}, {0, 0, 0}, {0, 0, 0}, {0, 0, 0},       {255, 230, 176}, {255, 230, 176}, {255, 230, 176}, {0, 0, 0},       {0, 0, 0},
                                {0, 0, 0}, {0, 0, 0}, {0, 0, 0}, {0, 0, 0}, {255, 230, 176}, {0, 49, 148},    {255, 230, 176}, {0, 49, 148},    {255, 230, 176}, {0, 0, 0},
                                {0, 0, 0}, {0, 0, 0}, {0, 0, 0}, {0, 0, 0}, {175, 35, 75},   {255, 230, 176}, {255, 230, 176}, {255, 230, 176}, {0, 0, 0},       {0, 0, 0},
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                                {0, 0, 0}, {0, 0, 0}, {0, 0, 0}, {0, 0, 0}, {0, 0, 0},       {0, 49, 148},    {0, 0, 0},       {0, 0, 0},       {0, 0, 0},       {0, 0, 0},
                            },
                        .duration = MULTIPLE_FRAME_DURATION},
                // ./imgs\4\3.png
                (Frame){.pixels =
                            {
                                {0, 0, 0}, {0, 0, 0}, {0, 0, 0}, {0, 0, 0},     {0, 0, 0},       {255, 230, 176}, {255, 230, 176}, {255, 230, 176}, {0, 0, 0},       {0, 0, 0},
                                {0, 0, 0}, {0, 0, 0}, {0, 0, 0}, {0, 0, 0},     {255, 230, 176}, {0, 49, 148},    {255, 230, 176}, {0, 49, 148},    {255, 230, 176}, {0, 0, 0},
                                {0, 0, 0}, {0, 0, 0}, {0, 0, 0}, {0, 0, 0},     {175, 35, 75},   {255, 230, 176}, {255, 230, 176}, {255, 230, 176}, {0, 0, 0},       {0, 0, 0},
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                                {0, 0, 0}, {0, 0, 0}, {0, 0, 0}, {0, 0, 0},     {0, 49, 148},    {0, 0, 0},       {0, 0, 0},       {0, 0, 0},       {0, 0, 0},       {0, 0, 0},
                            },
                        .duration = MULTIPLE_FRAME_DURATION},
                // ./imgs\4\4.png
                (Frame){.pixels =
                            {
                                {0, 0, 0}, {0, 0, 0}, {0, 0, 0},     {0, 0, 0},     {0, 0, 0},       {255, 230, 176}, {255, 230, 176}, {255, 230, 176}, {0, 0, 0},       {0, 0, 0},
                                {0, 0, 0}, {0, 0, 0}, {0, 0, 0},     {0, 0, 0},     {255, 230, 176}, {0, 49, 148},    {255, 230, 176}, {0, 49, 148},    {255, 230, 176}, {0, 0, 0},
                                {0, 0, 0}, {0, 0, 0}, {0, 0, 0},     {0, 0, 0},     {0, 0, 0},       {255, 230, 176}, {255, 230, 176}, {255, 230, 176}, {0, 0, 0},       {0, 0, 0},
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                                {0, 0, 0}, {0, 0, 0}, {0, 49, 148},  {0, 0, 0},     {0, 0, 0},       {0, 0, 0},       {0, 0, 0},       {0, 103, 181},   {0, 0, 0},       {0, 0, 0},
                            },
                        .duration = MULTIPLE_FRAME_DURATION},
                // ./imgs\4\5.png
                (Frame){.pixels =
                            {
                                {0, 0, 0}, {0, 0, 0}, {0, 0, 0},     {0, 0, 0},     {0, 0, 0},       {255, 230, 176}, {255, 230, 176}, {255, 230, 176}, {0, 0, 0},       {0, 0, 0},
                                {0, 0, 0}, {0, 0, 0}, {0, 0, 0},     {0, 0, 0},     {255, 230, 176}, {0, 49, 148},    {255, 230, 176}, {0, 49, 148},    {255, 230, 176}, {0, 0, 0},
                                {0, 0, 0}, {0, 0, 0}, {0, 0, 0},     {0, 0, 0},     {0, 0, 0},       {255, 230, 176}, {255, 230, 176}, {255, 230, 176}, {0, 0, 0},       {0, 0, 0},
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                                {0, 0, 0}, {0, 0, 0}, {0, 0, 0},     {0, 49, 148},  {0, 49, 148},    {0, 0, 0},       {0, 0, 0},       {0, 103, 181},   {0, 0, 0},       {0, 0, 0},
                            },
                        .duration = MULTIPLE_FRAME_DURATION},
                // ./imgs\4\6.png
                (Frame){.pixels =
                            {
                                {0, 0, 0}, {0, 0, 0}, {0, 0, 0}, {0, 0, 0},    {0, 0, 0},       {255, 230, 176}, {255, 230, 176}, {255, 230, 176}, {0, 0, 0},       {0, 0, 0},
                                {0, 0, 0}, {0, 0, 0}, {0, 0, 0}, {0, 0, 0},    {255, 230, 176}, {0, 49, 148},    {255, 230, 176}, {0, 49, 148},    {255, 230, 176}, {0, 0, 0},
                                {0, 0, 0}, {0, 0, 0}, {0, 0, 0}, {0, 0, 0},    {175, 35, 75},   {255, 230, 176}, {255, 230, 176}, {255, 230, 176}, {0, 0, 0},       {0, 0, 0},
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                                {0, 0, 0}, {0, 0, 0}, {0, 0, 0}, {0, 0, 0},    {0, 103, 181},   {0, 0, 0},       {0, 0, 0},       {0, 0, 0},       {0, 0, 0},       {0, 0, 0},
                            },
                        .duration = MULTIPLE_FRAME_DURATION},
            },
            .shiftMode = 0,
            .framesCount = 7},

    // ./imgs\5\..
    (Image){{
                // ./imgs\5\0.png
                (Frame){.pixels =
                            {
                                {0, 0, 0}, {0, 0, 0},      {0, 0, 0},      {0, 0, 0},       {0, 0, 0},      {0, 0, 0},      {0, 0, 0},       {0, 0, 0},       {0, 0, 0},      {0, 0, 0},
                                {0, 0, 0}, {0, 0, 0},      {0, 0, 0},      {0, 0, 0},       {0, 0, 0},      {0, 0, 0},      {0, 0, 0},       {0, 0, 0},       {0, 0, 0},      {0, 0, 0},
                                {0, 0, 0}, {0, 0, 0},      {0, 0, 0},      {0, 0, 0},       {0, 0, 0},      {0, 0, 0},      {0, 0, 0},       {0, 0, 0},       {0, 0, 0},      {0, 0, 0},
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                                {0, 0, 0}, {0, 0, 0},      {101, 243, 32}, {101, 243, 32},  {0, 0, 0},      {0, 0, 0},      {101, 243, 32},  {101, 243, 32},  {0, 0, 0},      {0, 0, 0},
                            },
                        .duration = MULTIPLE_FRAME_DURATION},
                // ./imgs\5\1.png
                (Frame){.pixels =
                            {
                                {0, 0, 0}, {0, 0, 0},      {0, 0, 0},      {0, 0, 0},       {0, 0, 0},      {0, 0, 0},      {0, 0, 0},       {0, 0, 0},       {0, 0, 0},      {0, 0, 0},
                                {0, 0, 0}, {0, 0, 0},      {0, 0, 0},      {0, 0, 0},       {0, 0, 0},      {0, 0, 0},      {0, 0, 0},       {0, 0, 0},       {0, 0, 0},      {0, 0, 0},
                                {0, 0, 0}, {0, 0, 0},      {0, 0, 0},      {0, 0, 0},       {48, 126, 14},  {101, 243, 32}, {0, 0, 0},       {0, 0, 0},       {0, 0, 0},      {0, 0, 0},
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                                {0, 0, 0}, {0, 0, 0},      {0, 0, 0},      {0, 0, 0},       {0, 0, 0},      {0, 0, 0},      {0, 0, 0},       {0, 0, 0},       {0, 0, 0},      {0, 0, 0},
                            },
                        .duration = MULTIPLE_FRAME_DURATION},
                // ./imgs\5\2.png
                (Frame){.pixels =
                            {
                                {0, 0, 0}, {0, 0, 0},      {0, 0, 0},      {48, 126, 14},   {101, 243, 32}, {101, 243, 32}, {181, 242, 150}, {0, 0, 0},       {0, 0, 0},      {0, 0, 0},
                                {0, 0, 0}, {0, 0, 0},      {48, 126, 14},  {143, 116, 239}, {101, 243, 32}, {101, 243, 32}, {143, 116, 239}, {181, 242, 150}, {0, 0, 0},      {0, 0, 0},
                                {0, 0, 0}, {101, 243, 32}, {101, 243, 32}, {254, 165, 233}, {101, 243, 32}, {101, 243, 32}, {254, 165, 233}, {101, 243, 32},  {101, 243, 32}, {0, 0, 0},
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                                {0, 0, 0}, {0, 0, 0},      {0, 0, 0},      {0, 0, 0},       {0, 0, 0},      {0, 0, 0},      {0, 0, 0},       {0, 0, 0},       {0, 0, 0},      {0, 0, 0},
                            },
                        .duration = MULTIPLE_FRAME_DURATION},
                // ./imgs\5\3.png
                (Frame){.pixels =
                            {
                                {0, 0, 0}, {0, 0, 0},      {0, 0, 0},      {0, 0, 0},       {0, 0, 0},      {0, 0, 0},      {0, 0, 0},       {0, 0, 0},       {0, 0, 0},      {0, 0, 0},
                                {0, 0, 0}, {0, 0, 0},      {0, 0, 0},      {0, 0, 0},       {0, 0, 0},      {0, 0, 0},      {0, 0, 0},       {0, 0, 0},       {0, 0, 0},      {0, 0, 0},
                                {0, 0, 0}, {0, 0, 0},      {0, 0, 0},      {48, 126, 14},   {101, 243, 32}, {101, 243, 32}, {181, 242, 150}, {0, 0, 0},       {0, 0, 0},      {0, 0, 0},
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                                {0, 0, 0}, {0, 0, 0},      {0, 0, 0},      {0, 0, 0},       {0, 0, 0},      {0, 0, 0},      {0, 0, 0},       {0, 0, 0},       {0, 0, 0},      {0, 0, 0},
                            },
                        .duration = MULTIPLE_FRAME_DURATION},
                // ./imgs\5\4.png
                (Frame){.pixels =
                            {
                                {0, 0, 0}, {0, 0, 0},      {0, 0, 0},      {0, 0, 0},       {0, 0, 0},      {0, 0, 0},      {0, 0, 0},       {0, 0, 0},       {0, 0, 0},      {0, 0, 0},
                                {0, 0, 0}, {0, 0, 0},      {0, 0, 0},      {0, 0, 0},       {0, 0, 0},      {0, 0, 0},      {0, 0, 0},       {0, 0, 0},       {0, 0, 0},      {0, 0, 0},
                                {0, 0, 0}, {0, 0, 0},      {0, 0, 0},      {0, 0, 0},       {0, 0, 0},      {0, 0, 0},      {0, 0, 0},       {0, 0, 0},       {0, 0, 0},      {0, 0, 0},
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                                {0, 0, 0}, {101, 243, 32}, {101, 243, 32}, {101, 243, 32},  {0, 0, 0},      {0, 0, 0},      {101, 243, 32},  {101, 243, 32},  {101, 243, 32}, {0, 0, 0},
                            },
                        .duration = MULTIPLE_FRAME_DURATION},
            },
            .shiftMode = 0,
            .framesCount = 5},

    // ./imgs\6\..
    (Image){{
                // ./imgs\6\0.png
                (Frame){.pixels =
                            {
                                {0, 0, 0},   {0, 0, 0},   {0, 0, 0},       {87, 67, 0},     {87, 67, 0},     {0, 0, 0},       {0, 0, 0},       {0, 0, 0},       {0, 0, 0},   {0, 0, 0},
                                {0, 0, 0},   {0, 0, 0},   {0, 0, 0},       {0, 0, 0},       {87, 67, 0},     {87, 67, 0},     {0, 0, 0},       {0, 0, 0},       {0, 0, 0},   {0, 0, 0},
                                {0, 0, 0},   {0, 0, 0},   {0, 0, 0},       {87, 67, 0},     {87, 67, 0},     {87, 67, 0},     {87, 67, 0},     {0, 0, 0},       {0, 0, 0},   {0, 0, 0},
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                                {0, 0, 0},   {87, 67, 0}, {87, 67, 0},     {87, 67, 0},     {87, 67, 0},     {87, 67, 0},     {87, 67, 0},     {87, 67, 0},     {87, 67, 0}, {0, 0, 0},
                            },
                        .duration = MULTIPLE_FRAME_DURATION},
                // ./imgs\6\1.png
                (Frame){.pixels =
                            {
                                {0, 0, 0},    {0, 242, 50}, {0, 242, 50}, {0, 0, 0},       {0, 0, 0},       {0, 242, 50},    {0, 0, 0},       {0, 0, 0},    {0, 0, 0},    {0, 0, 0},
                                {0, 0, 0},    {0, 0, 0},    {0, 242, 50}, {87, 67, 0},     {87, 67, 0},     {0, 242, 50},    {0, 0, 0},       {0, 0, 0},    {0, 242, 50}, {0, 0, 0},
                                {0, 0, 0},    {0, 0, 0},    {0, 242, 50}, {0, 242, 50},    {87, 67, 0},     {87, 67, 0},     {0, 242, 50},    {0, 0, 0},    {0, 0, 0},    {0, 0, 0},
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                                {0, 0, 0},    {87, 67, 0},  {87, 67, 0},  {87, 67, 0},     {87, 67, 0},     {87, 67, 0},     {87, 67, 0},     {87, 67, 0},  {87, 67, 0},  {0, 0, 0},
                            },
                        .duration = MULTIPLE_FRAME_DURATION},
                // ./imgs\6\2.png
                (Frame){.pixels =
                            {
                                {0, 0, 0},    {0, 175, 18}, {0, 175, 18}, {0, 0, 0},       {0, 0, 0},       {0, 0, 0},       {0, 0, 0},       {0, 0, 0},       {0, 0, 0},       {0, 0, 0},
                                {0, 0, 0},    {0, 0, 0},    {0, 175, 18}, {87, 67, 0},     {87, 67, 0},     {0, 175, 18},    {0, 0, 0},       {0, 0, 0},       {127, 128, 103}, {0, 0, 0},
                                {0, 0, 0},    {0, 0, 0},    {0, 0, 0},    {0, 175, 18},    {87, 67, 0},     {87, 67, 0},     {0, 175, 18},    {0, 0, 0},       {0, 0, 0},       {0, 0, 0},
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                                {0, 0, 0},    {87, 67, 0},  {87, 67, 0},  {87, 67, 0},     {87, 67, 0},     {87, 67, 0},     {87, 67, 0},     {87, 67, 0},     {87, 67, 0},     {0, 0, 0},
                            },
                        .duration = MULTIPLE_FRAME_DURATION},
                // ./imgs\6\3.png
                (Frame){.pixels =
                            {
                                {0, 0, 0},    {0, 175, 18}, {0, 175, 18}, {0, 0, 0},       {0, 0, 0},       {0, 0, 0},       {0, 0, 0},       {0, 0, 0},    {0, 0, 0},       {0, 0, 0},
                                {0, 0, 0},    {0, 0, 0},    {0, 175, 18}, {0, 175, 18},    {0, 175, 18},    {0, 175, 18},    {0, 0, 0},       {0, 0, 0},    {127, 128, 103}, {0, 0, 0},
                                {0, 0, 0},    {0, 0, 0},    {0, 0, 0},    {0, 175, 18},    {0, 175, 18},    {0, 175, 18},    {0, 175, 18},    {0, 0, 0},    {0, 0, 0},       {0, 0, 0},
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                                {0, 0, 0},    {0, 175, 18}, {87, 67, 0},  {87, 67, 0},     {87, 67, 0},     {87, 67, 0},     {87, 67, 0},     {87, 67, 0},  {0, 175, 18},    {0, 0, 0},
                            },
                        .duration = MULTIPLE_FRAME_DURATION},
                // ./imgs\6\4.png
                (Frame){.pixels =
                            {
                                {0, 0, 0},    {0, 175, 18}, {0, 175, 18}, {0, 0, 0},       {0, 0, 0},       {0, 0, 0},       {0, 0, 0},       {0, 0, 0},    {0, 0, 0},       {0, 0, 0},
                                {0, 0, 0},    {0, 0, 0},    {0, 175, 18}, {0, 175, 18},    {0, 175, 18},    {0, 175, 18},    {0, 0, 0},       {0, 0, 0},    {127, 128, 103}, {0, 0, 0},
                                {0, 0, 0},    {0, 0, 0},    {0, 0, 0},    {0, 175, 18},    {0, 175, 18},    {0, 175, 18},    {0, 175, 18},    {0, 0, 0},    {0, 0, 0},       {0, 0, 0},
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                                {0, 0, 0},    {0, 175, 18}, {0, 175, 18}, {0, 175, 18},    {0, 175, 18},    {0, 175, 18},    {0, 175, 18},    {0, 175, 18}, {0, 175, 18},    {0, 0, 0},
                            },
                        .duration = MULTIPLE_FRAME_DURATION},
                // ./imgs\6\5.png
                (Frame){.pixels =
                            {
                                {0, 0, 0},    {0, 0, 0},    {0, 0, 0},    {0, 0, 0},    {0, 0, 0},    {0, 0, 0},       {0, 0, 0},       {0, 0, 0},    {0, 0, 0},    {0, 0, 0},
                                {0, 0, 0},    {0, 0, 0},    {0, 0, 0},    {0, 0, 0},    {0, 0, 0},    {0, 0, 0},       {0, 0, 0},       {0, 0, 0},    {0, 0, 0},    {0, 0, 0},
                                {0, 0, 0},    {0, 0, 0},    {0, 175, 18}, {0, 175, 18}, {0, 0, 0},    {0, 0, 0},       {0, 0, 0},       {0, 0, 0},    {0, 0, 0},    {0, 0, 0},
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                                {0, 0, 0},    {0, 175, 18}, {0, 175, 18}, {0, 175, 18}, {0, 175, 18}, {0, 175, 18},    {0, 175, 18},    {0, 175, 18}, {0, 0, 0},    {0, 0, 0},
                            },
                        .duration = MULTIPLE_FRAME_DURATION},
            },
            .shiftMode = 0,
            .framesCount = 6},

    // ./imgs\7\..
    (Image){{
                // ./imgs\7\0.png
                (Frame){.pixels =
                            {
                                {0, 0, 0}, {0, 0, 0},       {0, 0, 0},       {0, 0, 0},       {0, 0, 0},     {157, 118, 66}, {113, 167, 25}, {167, 213, 10}, {167, 213, 10}, {0, 0, 0},
                                {0, 0, 0}, {0, 0, 0},       {0, 0, 0},       {0, 0, 0},       {0, 0, 0},     {157, 118, 66}, {113, 167, 25}, {167, 213, 10}, {167, 213, 10}, {0, 0, 0},
                                {0, 0, 0}, {0, 0, 0},       {0, 0, 0},       {0, 0, 0},       {0, 0, 0},     {157, 118, 66}, {0, 0, 0},      {0, 0, 0},      {0, 0, 0},      {0, 0, 0},
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                                {0, 0, 0}, {0, 0, 0},       {0, 0, 0},       {255, 49, 52},   {255, 49, 52}, {255, 49, 52},  {183, 38, 40},  {0, 0, 0},      {0, 0, 0},      {0, 0, 0},
                            },
                        .duration = MULTIPLE_FRAME_DURATION},
                // ./imgs\7\1.png
                (Frame){.pixels =
                            {
                                {0, 0, 0}, {0, 0, 0},       {0, 0, 0},       {0, 0, 0},       {0, 0, 0},     {157, 118, 66}, {113, 167, 25},  {167, 213, 10},  {167, 213, 10}, {0, 0, 0},
                                {0, 0, 0}, {0, 0, 0},       {0, 0, 0},       {0, 0, 0},       {0, 0, 0},     {157, 118, 66}, {113, 167, 25},  {167, 213, 10},  {167, 213, 10}, {0, 0, 0},
                                {0, 0, 0}, {0, 0, 0},       {0, 0, 0},       {0, 0, 0},       {0, 0, 0},     {157, 118, 66}, {0, 0, 0},       {0, 0, 0},       {0, 0, 0},      {0, 0, 0},
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                                {0, 0, 0}, {0, 0, 0},       {0, 0, 0},       {255, 49, 52},   {255, 49, 52}, {255, 49, 52},  {183, 38, 40},   {0, 0, 0},       {0, 0, 0},      {0, 0, 0},
                            },
                        .duration = MULTIPLE_FRAME_DURATION},
                // ./imgs\7\2.png
                (Frame){.pixels =
                            {
                                {0, 0, 0}, {0, 0, 0},       {0, 0, 0},       {0, 0, 0},       {0, 0, 0},     {157, 118, 66},  {113, 167, 25},  {167, 213, 10}, {167, 213, 10}, {0, 0, 0},
                                {0, 0, 0}, {0, 0, 0},       {0, 0, 0},       {0, 0, 0},       {0, 0, 0},     {157, 118, 66},  {113, 167, 25},  {167, 213, 10}, {167, 213, 10}, {0, 0, 0},
                                {0, 0, 0}, {0, 0, 0},       {0, 0, 0},       {0, 0, 0},       {0, 0, 0},     {157, 118, 66},  {0, 0, 0},       {0, 0, 0},      {0, 0, 0},      {0, 0, 0},
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                                {0, 0, 0}, {0, 0, 0},       {0, 0, 0},       {255, 49, 52},   {255, 49, 52}, {255, 49, 52},   {0, 0, 0},       {0, 0, 0},      {0, 0, 0},      {0, 0, 0},
                            },
                        .duration = MULTIPLE_FRAME_DURATION},
                // ./imgs\7\3.png
                (Frame){.pixels =
                            {
                                {0, 0, 0}, {0, 0, 0}, {0, 0, 0},       {0, 0, 0},       {0, 0, 0},     {157, 118, 66},  {113, 167, 25},  {167, 213, 10}, {167, 213, 10}, {0, 0, 0},
                                {0, 0, 0}, {0, 0, 0}, {0, 0, 0},       {0, 0, 0},       {0, 0, 0},     {157, 118, 66},  {113, 167, 25},  {167, 213, 10}, {167, 213, 10}, {0, 0, 0},
                                {0, 0, 0}, {0, 0, 0}, {0, 0, 0},       {0, 0, 0},       {0, 0, 0},     {157, 118, 66},  {0, 0, 0},       {0, 0, 0},      {0, 0, 0},      {0, 0, 0},
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                                {0, 0, 0}, {0, 0, 0}, {0, 0, 0},       {255, 49, 52},   {255, 49, 52}, {255, 49, 52},   {0, 0, 0},       {0, 0, 0},      {0, 0, 0},      {0, 0, 0},
                            },
                        .duration = MULTIPLE_FRAME_DURATION},
                // ./imgs\7\4.png
                (Frame){.pixels =
                            {
                                {0, 0, 0}, {0, 0, 0}, {0, 0, 0}, {0, 0, 0},       {0, 0, 0},     {157, 118, 66},  {113, 167, 25},  {167, 213, 10}, {167, 213, 10}, {0, 0, 0},
                                {0, 0, 0}, {0, 0, 0}, {0, 0, 0}, {0, 0, 0},       {0, 0, 0},     {157, 118, 66},  {113, 167, 25},  {167, 213, 10}, {167, 213, 10}, {0, 0, 0},
                                {0, 0, 0}, {0, 0, 0}, {0, 0, 0}, {0, 0, 0},       {0, 0, 0},     {157, 118, 66},  {0, 0, 0},       {0, 0, 0},      {0, 0, 0},      {0, 0, 0},
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                                {0, 0, 0}, {0, 0, 0}, {0, 0, 0}, {0, 0, 0},       {255, 49, 52}, {255, 49, 52},   {0, 0, 0},       {0, 0, 0},      {0, 0, 0},      {0, 0, 0},
                            },
                        .duration = MULTIPLE_FRAME_DURATION},
                // ./imgs\7\5.png
                (Frame){.pixels =
                            {
                                {0, 0, 0}, {0, 0, 0}, {0, 0, 0}, {0, 0, 0},       {0, 0, 0},       {157, 118, 66},  {113, 167, 25},  {167, 213, 10}, {167, 213, 10}, {0, 0, 0},
                                {0, 0, 0}, {0, 0, 0}, {0, 0, 0}, {0, 0, 0},       {0, 0, 0},       {157, 118, 66},  {113, 167, 25},  {167, 213, 10}, {167, 213, 10}, {0, 0, 0},
                                {0, 0, 0}, {0, 0, 0}, {0, 0, 0}, {0, 0, 0},       {0, 0, 0},       {157, 118, 66},  {0, 0, 0},       {0, 0, 0},      {0, 0, 0},      {0, 0, 0},
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                                {0, 0, 0}, {0, 0, 0}, {0, 0, 0}, {0, 0, 0},       {0, 0, 0},       {0, 0, 0},       {0, 0, 0},       {0, 0, 0},      {0, 0, 0},      {0, 0, 0},
                            },
                        .duration = MULTIPLE_FRAME_DURATION},
            },
            .shiftMode = 0,
            .framesCount = 6},

    // ./imgs\8\..
    (Image){{
                // ./imgs\8\0.png
                (Frame){.pixels =
                            {
                                {0, 0, 0},     {0, 0, 0},     {0, 0, 0},       {0, 0, 0},       {222, 221, 56},  {222, 221, 56},  {0, 0, 0},       {0, 0, 0},       {0, 0, 0},      {0, 0, 0},
                                {0, 0, 0},     {0, 0, 0},     {0, 0, 0},       {207, 192, 0},   {255, 252, 0},   {255, 252, 0},   {222, 221, 56},  {0, 0, 0},       {0, 0, 0},      {0, 0, 0},
                                {0, 0, 0},     {0, 0, 0},     {207, 192, 0},   {255, 252, 0},   {255, 254, 139}, {255, 254, 139}, {255, 252, 0},   {222, 221, 56},  {0, 0, 0},      {0, 0, 0},
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                                {0, 0, 0},     {0, 0, 0},     {0, 0, 0},       {0, 0, 0},       {222, 221, 56},  {222, 221, 56},  {0, 0, 0},       {0, 0, 0},       {0, 0, 0},      {0, 0, 0},
                            },
                        .duration = MULTIPLE_FRAME_DURATION},
                // ./imgs\8\1.png
                (Frame){.pixels =
                            {
                                {0, 0, 0}, {0, 0, 0},     {0, 0, 0},       {0, 0, 0},       {222, 221, 56},  {222, 221, 56},  {0, 0, 0},       {0, 0, 0},       {0, 0, 0},      {0, 0, 0},
                                {0, 0, 0}, {0, 0, 0},     {0, 0, 0},       {207, 192, 0},   {255, 252, 0},   {255, 252, 0},   {222, 221, 56},  {0, 0, 0},       {0, 0, 0},      {0, 0, 0},
                                {0, 0, 0}, {0, 0, 0},     {207, 192, 0},   {255, 252, 0},   {255, 254, 139}, {255, 254, 139}, {255, 252, 0},   {222, 221, 56},  {0, 0, 0},      {0, 0, 0},
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                                {0, 0, 0}, {0, 0, 0},     {0, 0, 0},       {0, 0, 0},       {222, 221, 56},  {222, 221, 56},  {0, 0, 0},       {0, 0, 0},       {0, 0, 0},      {0, 0, 0},
                            },
                        .duration = MULTIPLE_FRAME_DURATION},
                // ./imgs\8\2.png
                (Frame){.pixels =
                            {
                                {0, 0, 0}, {0, 0, 0}, {0, 0, 0},       {0, 0, 0},       {222, 221, 56},  {222, 221, 56},  {0, 0, 0},       {0, 0, 0},       {0, 0, 0},      {0, 0, 0},
                                {0, 0, 0}, {0, 0, 0}, {0, 0, 0},       {207, 192, 0},   {255, 252, 0},   {255, 252, 0},   {222, 221, 56},  {0, 0, 0},       {0, 0, 0},      {0, 0, 0},
                                {0, 0, 0}, {0, 0, 0}, {207, 192, 0},   {255, 252, 0},   {255, 254, 139}, {255, 254, 139}, {255, 252, 0},   {222, 221, 56},  {0, 0, 0},      {0, 0, 0},
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                                {0, 0, 0}, {0, 0, 0}, {0, 0, 0},       {0, 0, 0},       {222, 221, 56},  {222, 221, 56},  {0, 0, 0},       {0, 0, 0},       {0, 0, 0},      {0, 0, 0},
                            },
                        .duration = MULTIPLE_FRAME_DURATION},
                // ./imgs\8\3.png
                (Frame){.pixels =
                            {
                                {0, 0, 0}, {0, 0, 0}, {0, 0, 0}, {0, 0, 0},       {222, 221, 56},  {222, 221, 56},  {0, 0, 0},      {0, 0, 0},     {0, 0, 0}, {0, 0, 0},
                                {0, 0, 0}, {0, 0, 0}, {0, 0, 0}, {207, 192, 0},   {255, 252, 0},   {255, 252, 0},   {222, 221, 56}, {0, 0, 0},     {0, 0, 0}, {0, 0, 0},
                                {0, 0, 0}, {0, 0, 0}, {0, 0, 0}, {255, 252, 0},   {255, 254, 139}, {255, 254, 139}, {237, 229, 0},  {211, 198, 0}, {0, 0, 0}, {0, 0, 0},
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                                {0, 0, 0}, {0, 0, 0}, {0, 0, 0}, {0, 0, 0},       {222, 221, 56},  {222, 221, 56},  {0, 0, 0},      {0, 0, 0},     {0, 0, 0}, {0, 0, 0},
                            },
                        .duration = MULTIPLE_FRAME_DURATION},
                // ./imgs\8\4.png
                (Frame){.pixels =
                            {
                                {0, 0, 0}, {0, 0, 0},       {0, 0, 0}, {0, 0, 0},       {0, 0, 0}, {222, 221, 56},  {0, 0, 0}, {0, 0, 0},       {0, 0, 0}, {0, 0, 0},       {0, 0, 0}, {0, 0, 0},
                                {0, 0, 0}, {0, 0, 0},       {0, 0, 0}, {255, 252, 0},   {0, 0, 0}, {0, 0, 0},       {0, 0, 0}, {0, 0, 0},       {0, 0, 0}, {0, 0, 0},       {0, 0, 0}, {0, 0, 0},
                                {0, 0, 0}, {255, 254, 139}, {0, 0, 0}, {0, 0, 0},       {0, 0, 0}, {0, 0, 0},       {0, 0, 0}, {0, 0, 0},       {0, 0, 0}, {0, 0, 0},       {0, 0, 0}, {255, 254, 139},
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                                {0, 0, 0}, {0, 0, 0},       {0, 0, 0}, {0, 0, 0},
                            },
                        .duration = MULTIPLE_FRAME_DURATION},
                // ./imgs\8\5.png
                (Frame){.pixels =
                            {
                                {0, 0, 0}, {0, 0, 0}, {0, 0, 0}, {0, 0, 0},     {0, 0, 0},      {222, 221, 56},  {222, 221, 56},  {0, 0, 0},       {0, 0, 0}, {0, 0, 0},
                                {0, 0, 0}, {0, 0, 0}, {0, 0, 0}, {0, 0, 0},     {222, 221, 56}, {255, 252, 0},   {255, 252, 0},   {207, 192, 0},   {0, 0, 0}, {0, 0, 0},
                                {0, 0, 0}, {0, 0, 0}, {0, 0, 0}, {211, 198, 0}, {237, 229, 0},  {255, 254, 139}, {255, 254, 139}, {255, 252, 0},   {0, 0, 0}, {0, 0, 0},
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                                {0, 0, 0}, {0, 0, 0}, {0, 0, 0}, {0, 0, 0},     {0, 0, 0},      {222, 221, 56},  {222, 221, 56},  {0, 0, 0},       {0, 0, 0}, {0, 0, 0},
                            },
                        .duration = MULTIPLE_FRAME_DURATION},
                // ./imgs\8\6.png
                (Frame){.pixels =
                            {
                                {0, 0, 0}, {0, 0, 0}, {0, 0, 0},      {0, 0, 0},       {0, 0, 0},       {222, 221, 56},  {222, 221, 56},  {0, 0, 0},       {0, 0, 0},       {0, 0, 0},
                                {0, 0, 0}, {0, 0, 0}, {0, 0, 0},      {0, 0, 0},       {222, 221, 56},  {255, 252, 0},   {255, 252, 0},   {207, 192, 0},   {0, 0, 0},       {0, 0, 0},
                                {0, 0, 0}, {0, 0, 0}, {0, 0, 0},      {222, 221, 56},  {255, 252, 0},   {255, 254, 139}, {255, 254, 139}, {255, 252, 0},   {207, 192, 0},   {0, 0, 0},
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                                {0, 0, 0}, {0, 0, 0}, {0, 0, 0},      {0, 0, 0},       {0, 0, 0},       {222, 221, 56},  {222, 221, 56},  {0, 0, 0},       {0, 0, 0},       {0, 0, 0},
                            },
                        .duration = MULTIPLE_FRAME_DURATION},
            },
            .shiftMode = 0,
            .framesCount = 7},

    // ./imgs\9\..
    (Image){{
                // ./imgs\9\0.png
                (Frame){.pixels =
                            {
                                {0, 0, 0},     {157, 218, 0}, {157, 218, 0}, {0, 0, 0},     {0, 0, 0},     {0, 0, 0},     {0, 0, 0},     {0, 0, 0},     {0, 0, 0},     {0, 0, 0},
                                {157, 218, 0}, {157, 218, 0}, {81, 60, 8},   {157, 218, 0}, {0, 0, 0},     {0, 0, 0},     {157, 218, 0}, {157, 218, 0}, {157, 218, 0}, {0, 0, 0},
                                {157, 218, 0}, {157, 218, 0}, {157, 218, 0}, {157, 218, 0}, {0, 0, 0},     {157, 218, 0}, {0, 0, 0},     {0, 0, 0},     {157, 218, 0}, {0, 147, 30},
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                                {0, 0, 0},     {0, 0, 0},     {0, 0, 0},     {157, 218, 0}, {157, 218, 0}, {0, 0, 0},     {0, 0, 0},     {157, 218, 0}, {157, 218, 0}, {0, 0, 0},
                            },
                        .duration = MULTIPLE_FRAME_DURATION},
                // ./imgs\9\1.png
                (Frame){.pixels =
                            {
                                {0, 0, 0},     {157, 218, 0}, {157, 218, 0}, {0, 0, 0},     {0, 0, 0},     {0, 0, 0},     {0, 0, 0},     {0, 0, 0},     {0, 0, 0},     {0, 0, 0},
                                {157, 218, 0}, {157, 218, 0}, {81, 60, 8},   {157, 218, 0}, {0, 0, 0},     {0, 0, 0},     {157, 218, 0}, {157, 218, 0}, {157, 218, 0}, {0, 0, 0},
                                {157, 218, 0}, {157, 218, 0}, {157, 218, 0}, {157, 218, 0}, {0, 0, 0},     {0, 0, 0},     {0, 0, 0},     {0, 0, 0},     {157, 218, 0}, {0, 147, 30},
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                                {0, 0, 0},     {0, 0, 0},     {0, 0, 0},     {0, 0, 0},     {0, 147, 30},  {0, 147, 30},  {0, 0, 0},     {0, 0, 0},     {0, 0, 0},     {0, 0, 0},
                            },
                        .duration = MULTIPLE_FRAME_DURATION},
                // ./imgs\9\2.png
                (Frame){.pixels =
                            {
                                {0, 0, 0},     {157, 218, 0}, {157, 218, 0}, {157, 218, 0}, {0, 0, 0},     {0, 0, 0},     {0, 0, 0},     {0, 0, 0},     {0, 0, 0},     {0, 0, 0},
                                {157, 218, 0}, {157, 218, 0}, {157, 218, 0}, {81, 60, 8},   {157, 218, 0}, {0, 0, 0},     {0, 0, 0},     {0, 0, 0},     {0, 0, 0},     {0, 0, 0},
                                {157, 218, 0}, {157, 218, 0}, {157, 218, 0}, {157, 218, 0}, {157, 218, 0}, {0, 0, 0},     {0, 0, 0},     {0, 0, 0},     {0, 0, 0},     {157, 218, 0},
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                                {0, 0, 0},     {0, 0, 0},     {0, 0, 0},     {0, 0, 0},     {0, 147, 30},  {0, 147, 30},  {157, 218, 0}, {157, 218, 0}, {0, 0, 0},     {0, 0, 0},
                            },
                        .duration = MULTIPLE_FRAME_DURATION},
                // ./imgs\9\3.png
                (Frame){.pixels =
                            {
                                {0, 0, 0}, {0, 0, 0}, {0, 0, 0},     {157, 218, 0}, {157, 218, 0}, {157, 218, 0}, {0, 0, 0},     {0, 0, 0},     {0, 0, 0},     {0, 0, 0},
                                {0, 0, 0}, {0, 0, 0}, {157, 218, 0}, {157, 218, 0}, {157, 218, 0}, {81, 60, 8},   {157, 218, 0}, {0, 0, 0},     {0, 0, 0},     {0, 0, 0},
                                {0, 0, 0}, {0, 0, 0}, {157, 218, 0}, {157, 218, 0}, {157, 218, 0}, {157, 218, 0}, {157, 218, 0}, {0, 0, 0},     {0, 0, 0},     {157, 218, 0},
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                                {0, 0, 0}, {0, 0, 0}, {0, 0, 0},     {0, 0, 0},     {157, 218, 0}, {157, 218, 0}, {0, 147, 30},  {0, 147, 30},  {0, 0, 0},     {0, 0, 0},
                            },
                        .duration = MULTIPLE_FRAME_DURATION},
                // ./imgs\9\4.png
                (Frame){.pixels =
                            {
                                {0, 0, 0}, {0, 0, 0},     {0, 0, 0},     {0, 0, 0},     {157, 218, 0}, {157, 218, 0}, {157, 218, 0}, {0, 0, 0},     {0, 0, 0},     {0, 0, 0},
                                {0, 0, 0}, {0, 0, 0},     {0, 0, 0},     {157, 218, 0}, {157, 218, 0}, {157, 218, 0}, {81, 60, 8},   {157, 218, 0}, {0, 0, 0},     {0, 0, 0},
                                {0, 0, 0}, {0, 0, 0},     {243, 255, 0}, {243, 255, 0}, {157, 218, 0}, {157, 218, 0}, {157, 218, 0}, {157, 218, 0}, {0, 0, 0},     {157, 218, 0},
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                                {0, 0, 0}, {0, 0, 0},     {0, 0, 0},     {0, 0, 0},     {157, 218, 0}, {157, 218, 0}, {0, 147, 30},  {0, 147, 30},  {0, 0, 0},     {0, 0, 0},
                            },
                        .duration = MULTIPLE_FRAME_DURATION},
                // ./imgs\9\5.png
                (Frame){.pixels =
                            {
                                {243, 255, 0}, {0, 0, 0},     {0, 0, 0},     {0, 0, 0},     {157, 218, 0}, {157, 218, 0}, {157, 218, 0}, {0, 0, 0},     {0, 0, 0},     {0, 0, 0},
                                {255, 196, 0}, {243, 255, 0}, {0, 0, 0},     {157, 218, 0}, {157, 218, 0}, {157, 218, 0}, {81, 60, 8},   {157, 218, 0}, {0, 0, 0},     {0, 0, 0},
                                {255, 28, 0},  {255, 28, 0},  {255, 196, 0}, {243, 255, 0}, {157, 218, 0}, {157, 218, 0}, {157, 218, 0}, {157, 218, 0}, {0, 0, 0},     {157, 218, 0},
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                                {0, 0, 0},     {0, 0, 0},     {0, 0, 0},     {0, 0, 0},     {157, 218, 0}, {157, 218, 0}, {0, 147, 30},  {0, 147, 30},  {0, 0, 0},     {0, 0, 0},
                            },
                        .duration = MULTIPLE_FRAME_DURATION},
            },
            .shiftMode = 0,
            .framesCount = 6},

    // SINGLEFRAME_IMAGES

    // ./imgs\222222.png
    (Image){{
                (Frame){.pixels =
                            {
                                {0, 0, 0},     {0, 0, 0},     {0, 0, 0},     {0, 0, 0},       {0, 0, 0},     {0, 0, 0},     {0, 0, 0},       {0, 0, 0},     {0, 0, 0},    {0, 0, 0},
                                {0, 0, 0},     {0, 0, 0},     {0, 0, 0},     {0, 0, 0},       {0, 0, 0},     {0, 0, 0},     {0, 0, 0},       {0, 0, 0},     {0, 0, 0},    {0, 0, 0},
                                {0, 0, 0},     {0, 0, 0},     {0, 0, 0},     {0, 143, 46},    {0, 143, 46},  {0, 0, 0},     {0, 143, 46},    {0, 143, 46},  {0, 0, 0},    {0, 0, 0},
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                                {0, 0, 0},     {0, 0, 0},     {0, 0, 0},     {0, 0, 0},       {0, 0, 0},     {0, 0, 0},     {0, 0, 0},       {0, 0, 0},     {0, 0, 0},    {0, 0, 0},
                            },
                        .duration = SINGEL_FRAME_DURATION},
            },
            .shiftMode = 0,
            .framesCount = 1},

};

const uint8_t baseImagesSize = sizeof(baseImages) / sizeof(baseImages[0]);

const Image errorImage =
    (Image){{
                (Frame){.pixels =
                            {
                                {255, 0, 0}, {0, 0, 0},   {0, 0, 0},   {0, 0, 0},   {0, 0, 0}, {0, 0, 0},   {0, 0, 0},   {0, 0, 0},   {0, 0, 0},   {255, 0, 0}, {0, 0, 0},   {255, 0, 0}, {0, 0, 0},
                                {0, 0, 0},   {0, 0, 0},   {0, 0, 0},   {0, 0, 0},   {0, 0, 0}, {255, 0, 0}, {0, 0, 0},   {0, 0, 0},   {0, 0, 0},   {255, 0, 0}, {0, 0, 0},   {0, 0, 0},   {0, 0, 0},
                                {0, 0, 0},   {255, 0, 0}, {0, 0, 0},   {0, 0, 0},   {0, 0, 0}, {0, 0, 0},   {0, 0, 0},   {255, 0, 0}, {0, 0, 0},   {0, 0, 0},   {255, 0, 0}, {0, 0, 0},   {0, 0, 0},
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                                {0, 0, 0},   {0, 0, 0},   {0, 0, 0},   {0, 0, 0},   {0, 0, 0}, {0, 0, 0},   {0, 0, 0},   {0, 0, 0},   {255, 0, 0},
                            },
                        .duration = 1000},
            },
            .shiftMode = 0,
            .framesCount = 1};

const Image successImage =
    (Image){{
                (Frame){.pixels =
                            {
                                {0, 0, 0},     {0, 0, 0}, {0, 0, 0}, {0, 0, 0},     {0, 0, 0}, {0, 0, 0}, {0, 0, 0},     {0, 0, 0}, {0, 0, 0}, {0, 0, 0},     {0, 0, 0},     {0, 0, 0},
                                {0, 0, 0},     {0, 0, 0}, {0, 0, 0}, {0, 0, 0},     {0, 0, 0}, {0, 0, 0}, {0, 0, 0},     {0, 0, 0}, {0, 0, 0}, {0, 0, 0},     {0, 0, 0},     {0, 0, 0},
                                {0, 0, 0},     {0, 0, 0}, {0, 0, 0}, {0, 0, 0},     {0, 0, 0}, {0, 0, 0}, {0, 0, 0},     {0, 0, 0}, {0, 0, 0}, {0, 0, 0},     {0, 0, 0},     {0, 0, 0},
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                                {0, 0, 0},     {0, 0, 0}, {0, 0, 0}, {0, 0, 0},
                            },
                        .duration = 1000},
            },
            .shiftMode = 0,
            .framesCount = 1};

const Image loadImage = (Image){{
                                    (Frame){.pixels =
                                                {
                                                    {0, 0, 0}, {0, 0, 0},   {0, 0, 0},     {0, 0, 0},     {76, 175, 80}, {76, 175, 80}, {0, 0, 0},     {0, 0, 0},     {0, 0, 0},   {0, 0, 0},
                                                    {0, 0, 0}, {0, 0, 0},   {0, 0, 0},     {0, 0, 0},     {76, 175, 80}, {76, 175, 80}, {0, 0, 0},     {0, 0, 0},     {0, 0, 0},   {0, 0, 0},
                                                    {0, 0, 0}, {0, 0, 0},   {0, 0, 0},     {0, 0, 0},     {76, 175, 80}, {76, 175, 80}, {0, 0, 0},     {0, 0, 0},     {0, 0, 0},   {0, 0, 0},
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                                                    {0, 0, 0}, {0, 0, 0},   {0, 0, 0},     {0, 0, 0},     {0, 0, 0},     {0, 0, 0},     {0, 0, 0},     {0, 0, 0},     {0, 0, 0},   {0, 0, 0},
                                                },
                                            .duration = 1000},
                                },
                                .shiftMode = 0,
                                .framesCount = 1};

const Image lowBattery = (Image){
    {
        (Frame){.pixels =
                    {
                        {0, 0, 0},       {0, 0, 0},       {0, 0, 0},       {0, 0, 0},       {0, 0, 0},       {0, 0, 0},       {0, 0, 0},       {0, 0, 0},       {0, 0, 0},       {0, 0, 0},
                        {0, 0, 0},       {0, 0, 0},       {0, 0, 0},       {0, 0, 0},       {0, 0, 0},       {0, 0, 0},       {0, 0, 0},       {0, 0, 0},       {0, 0, 0},       {0, 0, 0},
                        {255, 255, 255}, {255, 255, 255}, {255, 255, 255}, {255, 255, 255}, {255, 255, 255}, {255, 255, 255}, {255, 255, 255}, {255, 255, 255}, {255, 255, 255}, {0, 0, 0},
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                        {0, 0, 0},       {0, 0, 0},       {0, 0, 0},       {0, 0, 0},       {0, 0, 0},       {0, 0, 0},       {0, 0, 0},       {0, 0, 0},       {0, 0, 0},       {0, 0, 0},
                    },
                .duration = 1000},
    },
    .shiftMode = 0,
    .framesCount = 1};
const Image mediumBattery = (Image){
    {
        (Frame){.pixels =
                    {
                        {0, 0, 0},       {0, 0, 0},       {0, 0, 0},       {0, 0, 0},       {0, 0, 0},       {0, 0, 0},       {0, 0, 0},       {0, 0, 0},       {0, 0, 0},       {0, 0, 0},
                        {0, 0, 0},       {0, 0, 0},       {0, 0, 0},       {0, 0, 0},       {0, 0, 0},       {0, 0, 0},       {0, 0, 0},       {0, 0, 0},       {0, 0, 0},       {0, 0, 0},
                        {255, 255, 255}, {255, 255, 255}, {255, 255, 255}, {255, 255, 255}, {255, 255, 255}, {255, 255, 255}, {255, 255, 255}, {255, 255, 255}, {255, 255, 255}, {0, 0, 0},
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                        {0, 0, 0},       {0, 0, 0},       {0, 0, 0},       {0, 0, 0},       {0, 0, 0},       {0, 0, 0},       {0, 0, 0},       {0, 0, 0},       {0, 0, 0},       {0, 0, 0},
                    },
                .duration = 1000},
    },
    .shiftMode = 0,
    .framesCount = 1};
const Image greenBattery = (Image){
    {
        (Frame){.pixels =
                    {
                        {0, 0, 0},       {0, 0, 0},       {0, 0, 0},       {0, 0, 0},       {0, 0, 0},       {0, 0, 0},       {0, 0, 0},       {0, 0, 0},       {0, 0, 0},       {0, 0, 0},
                        {0, 0, 0},       {0, 0, 0},       {0, 0, 0},       {0, 0, 0},       {0, 0, 0},       {0, 0, 0},       {0, 0, 0},       {0, 0, 0},       {0, 0, 0},       {0, 0, 0},
                        {255, 255, 255}, {255, 255, 255}, {255, 255, 255}, {255, 255, 255}, {255, 255, 255}, {255, 255, 255}, {255, 255, 255}, {255, 255, 255}, {255, 255, 255}, {0, 0, 0},
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                        {0, 0, 0},       {0, 0, 0},       {0, 0, 0},       {0, 0, 0},       {0, 0, 0},       {0, 0, 0},       {0, 0, 0},       {0, 0, 0},       {0, 0, 0},       {0, 0, 0},
                    },
                .duration = 1000},
    },
    .shiftMode = 0,
    .framesCount = 1};
const Image fullBattery = (Image){
    {
        (Frame){.pixels =
                    {
                        {0, 0, 0},       {0, 0, 0},       {0, 0, 0},       {0, 0, 0},       {0, 0, 0},       {0, 0, 0},       {0, 0, 0},       {0, 0, 0},       {0, 0, 0},       {0, 0, 0},
                        {0, 0, 0},       {0, 0, 0},       {0, 0, 0},       {0, 0, 0},       {0, 0, 0},       {0, 0, 0},       {0, 0, 0},       {0, 0, 0},       {0, 0, 0},       {0, 0, 0},
                        {255, 255, 255}, {255, 255, 255}, {255, 255, 255}, {255, 255, 255}, {255, 255, 255}, {255, 255, 255}, {255, 255, 255}, {255, 255, 255}, {255, 255, 255}, {0, 0, 0},
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                        {0, 0, 0},       {0, 0, 0},       {0, 0, 0},       {0, 0, 0},       {0, 0, 0},       {0, 0, 0},       {0, 0, 0},       {0, 0, 0},       {0, 0, 0},       {0, 0, 0},
                    },
                .duration = 1000},
    },
    .shiftMode = 0,
    .framesCount = 1};

const Image carrot = (Image){{
                                 (Frame){.pixels =
                                             {
                                                 {0, 0, 0}, {0, 0, 0}, {0, 0, 0},     {0, 0, 0},     {0, 0, 0},     {0, 0, 0},       {0, 0, 0},     {0, 0, 0},     {0, 0, 0}, {0, 0, 0},
                                                 {0, 0, 0}, {0, 0, 0}, {0, 0, 0},     {76, 175, 80}, {0, 0, 0},     {76, 175, 80},   {0, 0, 0},     {76, 175, 80}, {0, 0, 0}, {0, 0, 0},
                                                 {0, 0, 0}, {0, 0, 0}, {0, 0, 0},     {0, 0, 0},     {76, 175, 80}, {158, 224, 122}, {76, 175, 80}, {0, 0, 0},     {0, 0, 0}, {0, 0, 0},
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                                                 {0, 0, 0}, {0, 0, 0}, {0, 0, 0},     {0, 0, 0},     {255, 87, 34}, {255, 87, 34},   {0, 0, 0},     {0, 0, 0},     {0, 0, 0}, {0, 0, 0},
                                             },
                                         .duration = 1000},
                             },
                             .shiftMode = 0,
                             .framesCount = 1};
